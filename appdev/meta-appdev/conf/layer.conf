## layers/meta-ebclfsa/meta-ebclfsa-public/conf/machine/ebcl-qemuamd64.conf
```bitbake
# Copyright 2026 Elektrobit. All rights reserved.

require conf/machine/qemuamd64.conf
```

## layers/meta-ebclfsa/meta-ebclfsa-public/conf/machine/ebcl-qemuarm64.conf
```bitbake
# Copyright 2026 Elektrobit. All rights reserved.

require conf/machine/qemuarm64.conf

EBCL_PLATFORM = "qemu"
```

## layers/meta-ebclfsa/meta-ebclfsa-public/meta-ebclfsa-public-bsp/meta-ebclfsa-public-bsp-rpi/conf/machine/rpi4b.conf
```bitbake
#
# Copyright 2026 Elektrobit. All rights reserved.
#
# Machine definition for the Raspberry Pi 4B platform.

DISTRO_ARCH ?= "arm64"
MACHINE_SERIAL ?= "serial0"
BAUDRATE_TTY ?= "115200"

EBCL_BOOTLOADER_PACKAGES ?= " \
    bootconfig-rpi4b \
    firmware-rpi \
"

IMAGE_BOOT_FILES ?= "${IMAGE_ROOTFS}/boot/vmlinux*;./ \
                     ${IMAGE_ROOTFS}/boot/uboot*;./ \
                     ${IMAGE_ROOTFS}/boot/System.map*;./ \
                     ${IMAGE_ROOTFS}/boot/cmdline.txt;./ \
                     ${IMAGE_ROOTFS}/boot/config.txt;./ \
                     ${IMAGE_ROOTFS}/usr/lib/rpi-firmware/*.bin;./ \
                     ${IMAGE_ROOTFS}/usr/lib/rpi-firmware/*.dat;./ \
                     ${IMAGE_ROOTFS}/usr/lib/rpi-firmware/*.elf;./ \
                     ${IMAGE_ROOTFS}/usr/lib/rpi-firmware/*.dtb;./ \
                     ${IMAGE_ROOTFS}/usr/lib/rpi-firmware/overlays/*.dtbo;./overlays/"

EBCLFSA_LIVM_DEV = "mmcblk0p2"

EBCL_PLATFORM = "rpi4b"

BSP_LAYERDIR := "${LAYERDIR_meta-ebclfsa-public-bsp-rpi}"
```

## layers/meta-features-public/meta-features-public-ankaios/meta-features-public-ankaios-integration/conf/layer.conf
```bitbake
# Copyright 2026 Elektrobit. All rights reserved.

BBPATH .= ":${LAYERDIR}"
BBFILES += "${LAYERDIR}/recipes-*/*/*.bb \
            ${LAYERDIR}/recipes-*/*/*.bbappend"

BBFILE_COLLECTIONS += "meta-features-public-ankaios-integration"
BBFILE_PATTERN_meta-features-public-ankaios-integration = "^${LAYERDIR}/"
BBFILE_PRIORITY_meta-features-public-ankaios-integration = "6"

LAYERDEPENDS_meta-features-public-ankaios-integration = "core"
LAYERSERIES_COMPAT_meta-features-public-ankaios-integration = "v0.6"
```

## layers/meta-features/meta-features-public/meta-features-public-yoriito/meta-features-public-yoriito-integration/conf/distro/include/virtual.inc
```bitbake
# Copyright 2026 Elektrobit. All rights reserved.

PREFERRED_PROVIDER_virtual/yoriito-viss-server ??= "kura"
PREFERRED_RPROVIDER_yoriito-viss-server ??= "kura"
PREFERRED_PROVIDER_virtual/yoriito-viss-client ??= "kura-client"
PREFERRED_RPROVIDER_yoriito-viss-client ??= "kura-client"
```

## layers/meta-features/meta-features-public/meta-features-public-yoriito/meta-features-public-yoriito-integration/conf/layer.conf
```bitbake
# Copyright 2026 Elektrobit. All rights reserved.

# We have a conf and classes directory, add to BBPATH
BBPATH .= ":${LAYERDIR}"

# We have recipes-* directories, add to BBFILES
BBFILES += "${LAYERDIR}/recipes-*/*/*.bb \
            ${LAYERDIR}/recipes-*/*/*.bbappend"

BBFILE_COLLECTIONS += "meta-features-public-yoriito-integration"
BBFILE_PATTERN_meta-features-public-yoriito-integration = "^${LAYERDIR}/"
BBFILE_PRIORITY_meta-features-public-yoriito-integration = "6"

LAYERDEPENDS_meta-features-public-yoriito-integration = "core"
LAYERSERIES_COMPAT_yoriito-layer = "v0.6"

LICENSE_PATH += "${LAYERDIR}/licenses"
YORIITO_LICENSE_PATH = "${LAYERDIR}/licenses"

require conf/distro/include/virtual.inc

REPO_YORIITO_DEBIAN_UPSTREAM_APT ??= "https://deb.debian.org/debian"
```
